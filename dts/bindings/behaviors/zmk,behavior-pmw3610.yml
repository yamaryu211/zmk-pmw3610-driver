## dts/bindings/behaviors/zmk,behavior-pmw3610.yml
```yaml
description: pmw3610 behavior

compatible: "zmk,behavior-pmw3610"

include: zero_param.yaml

properties:
  pixart_dev:
    type: phandle
    required: true
  increase_cpi:
    type: boolean
  decrease_cpi:
    type: boolean
```

## dts/bindings/pixart,pmw3610.yml
```yaml
description: |
  Sensor driver for the pixart PMW3610 mouse sensor

compatible: "pixart,pmw3610"

include: spi-device.yaml

properties:
  irq-gpios:
    type: phandle-array
    required: true
  scroll-layers:
    type: array
    default: []
  snipe-layers:
    type: array
    default: []
  automouse-layer:
    type: int
    default: -1
  scroll-snap:
    type: boolean
    description: "Enable scroll snap to axis functionality"
  scroll-snap-threshold:
    type: int
    description: "Scroll snap threshold (1-100). Lower values make snapping more aggressive"
  scroll-snap-strength:
    type: int
    description: "Scroll snap strength (1-100). Higher values create stronger snapping"
  scroll-snap-mode-axis-lock:
    type: boolean
    description: "Enable axis lock mode for scroll snap"
  scroll-snap-axis-lock-timeout-ms:
    type: int
    description: "Axis lock timeout in milliseconds (100-5000)"
  scroll-acceleration:
    type: boolean
    description: "Enable scroll acceleration functionality"
  scroll-acceleration-sensitivity:
    type: int
    description: "Scroll acceleration sensitivity (1-10)"

child-binding:
  description: "Invoke behaviors when the track ball is moved on specific layers"
  properties:
    layers:
      description: "Layers on which the behavior will be invoked"
      type: array
      required: true
    bindings:
      description: "Behaviors to be invoked"
      type: phandle-array
      required: true
    tick:
      description: "Required ticks to trigger a ball action. Higher values require more movement to trigger a ball action. If omitted, CONFIG_PMW3610_BALL_ACTION_TICK will be used."
      type: int
    wait-ms:
      description: "Time to wait (in milliseconds) before triggering the next behavior binding. If omitted, it will be set to 0."
      type: int
    tap-ms:
      description: "Time to wait (in milliseconds) between the press and release events on a triggered behavior binding. If omitted, it will be set to 0."
      type: int
```
