&pmw3610 {
	irq-gpios = <&gpio0 6 (GPIO_ACTIVE_HIGH | GPIO_PULL_DOWN)>;
	scroll-layers = <4>;
	snipe-layers = <5>;
	automouse-layer = <6>;
	
	/* Scroll acceleration settings */
	scroll-acceleration;
	scroll-acceleration-sensitivity = <5>;
	
	/* Scroll snap settings */
	scroll-snap;
	scroll-snap-threshold = <30>;
	scroll-snap-strength = <70>;
	scroll-snap-mode-axis-lock;
	scroll-snap-axis-lock-timeout-ms = <1000>;
}; 